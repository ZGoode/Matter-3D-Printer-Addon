## src/NRF5340-NRF7002/Matter_PrintNode/build/Kconfig/Kconfig.shield.defconfig
```kconfig
osource "/home/zachary/Documents/nrf/light_switch/boards/shields/*/Kconfig.defconfig"
osource "/home/zachary/Documents/nrf/test_template/boards/shields/*/Kconfig.defconfig"
osource "/home/zachary/ncs/v2.5.0/nrf/boards/shields/*/Kconfig.defconfig"
```

## src/NRF5340-NRF7002/test_template/build/Kconfig/Kconfig.shield
```kconfig
osource "/home/zachary/Documents/nrf/light_switch/boards/shields/*/Kconfig.shield"
osource "/home/zachary/Documents/nrf/test_template/boards/shields/*/Kconfig.shield"
osource "/home/zachary/ncs/v2.5.0/nrf/boards/shields/*/Kconfig.shield"
```

## src/NRF5340-NRF7002/test_template/build/hci_rpmsg/b0n/Kconfig/Kconfig.sysbuild.modules
```kconfig
menu "nrf (/home/zachary/ncs/v2.5.0/nrf)"
osource "/home/zachary/ncs/v2.5.0/nrf/sysbuild/Kconfig.sysbuild"
config ZEPHYR_NRF_MODULE
	bool
	default y
endmenu
```

## prj.conf
```kconfig
#
# Copyright (c) 2021 Nordic Semiconductor ASA
#
# SPDX-License-Identifier: LicenseRef-Nordic-5-Clause
#

# This sample uses Kconfig.defaults to set options common for all
# samples. This file should contain only options specific for this sample
# or overrides of default values.

# Enable CHIP
CONFIG_CHIP=y
CONFIG_CHIP_ENABLE_PAIRING_AUTOSTART=y
CONFIG_CHIP_PROJECT_CONFIG="src/chip_project_config.h"
# 32768 == 0x8000 (example Product ID added temporaly,
# but it must be changed with proper PID from the list:
# https://github.com/project-chip/connectedhomeip/blob/482e6fd03196a6de45465a90003947ef4b86e0b1/docs/examples/discussion/PID_allocation_for_example_apps.md)
CONFIG_CHIP_DEVICE_PRODUCT_ID=32768
CONFIG_STD_CPP14=y

#CONFIG_USB_DEVICE_STACK=y
#CONFIG_USB_CDC_ACM=y

# Add support for LEDs and buttons on Nordic development kits
CONFIG_DK_LIBRARY=y

# Bluetooth Low Energy configuration
CONFIG_BT_DEVICE_NAME="MatterTemplate"

# Other settings
CONFIG_THREAD_NAME=y
CONFIG_MPU_STACK_GUARD=y
CONFIG_RESET_ON_FATAL_ERROR=n
CONFIG_CHIP_LIB_SHELL=y

# Disable NFC commissioning
CONFIG_CHIP_NFC_COMMISSIONING=n

# Reduce application size
CONFIG_USE_SEGGER_RTT=n

# Enable Factory Data feature
CONFIG_CHIP_FACTORY_DATA=y
CONFIG_CHIP_FACTORY_DATA_BUILD=y

# CONFIG_LOG=n
```

## src/3D_Print_UART_Data.cpp
```c
#include "3D_Print_UART_Data.h"

char bufferChar[64];

float temperatures[4];
long long value1, value2;

int checkUARTDataInput(const char *input, const char *check) {
	if ((input == NULL || check == NULL)) {
		return -1;
	}

	char *result = strstr(input, check);

	if (result == NULL) {
		return -1;
	} else {
		return 1;
	}
}

void extractTemperatureData(const char *input, int maxNumbers) {
    if (input == NULL || temperatures == NULL || maxNumbers <= 0) {
        // Check for NULL pointers and invalid parameters
        return;
    }

    int numCount = 0; // Counter for the numbers found
    char *endPtr;     // Pointer to detect the end of the number conversion

    // Loop through the input string
    for (const char *ptr = input; *ptr != '\0'; ++ptr) {
        if (numCount >= maxNumbers) {
            break; // Stop if we've reached the maximum number count
        }

        // Skip non-numeric characters and separators
        while (*ptr != '\0' && !isdigit(*ptr) && *ptr != '-' && *ptr != '.' && *ptr != ',') {
            ptr++;
        }

        if (*ptr == '\0') {
            break; // Exit if we reached the end of the string
        }

        // Try to convert a number starting from the current position
        double num = strtod(ptr, &endPtr);

        if (ptr != endPtr) {
            temperatures[numCount] = num;
            numCount++;
        }

        // Move the pointer to the next character after the converted number
        ptr = endPtr;
    }
}

int extractLongLongs(const char *input) {
    int valuesExtracted = 0;
    const char *startPtr = input;

    while (*startPtr) {
        // Skip non-numeric characters
        while (*startPtr && !isdigit(*startPtr)) {
            startPtr++;
        }

        if (*startPtr) {
            // Use strtoll to extract the long long value
            char *endPtr;
            long long extractedValue = strtoll(startPtr, &endPtr, 10);

            if (endPtr > startPtr) {
                if (valuesExtracted == 0) {
                    value1 = extractedValue;
                } else if (valuesExtracted == 1) {
                    value2 = extractedValue;
                }
                valuesExtracted++;

                startPtr = endPtr;
            } else {
                // If no valid number is found, move to the next character
                startPtr++;
            }
        }
    }

    return (valuesExtracted == 2);
}

void longLongToChar(long long num, char *str) {
    if (num < 0) {
        *str++ = '-';
        num = -num;
    }

    char temp[21]; // Assuming a long long can be represented in at most 20 characters plus the null terminator
    int i = 0;

    do {
        temp[i++] = num % 10 + '0';
        num /= 10;
    } while (num != 0);

    while (i > 0) {
        *str++ = temp[--i];
    }
    *str = '\0';
}

uint8_t returnSDPercentage() {
    if (value2 == 0) {
        // Handle division by zero
        printk("Error: Division by zero.\n");
        return 0;
    }

    // Perform the division
    uint8_t result = (int)((float)((float)value1 / (float)value2) * 100);

    return result;
}

void floatToChar(float num, int precision) {
    int wholePart = (int)num;
    float fractionalPart = num - wholePart;
    
    // Convert the whole part to a string
    int wholeLength = 0;
    if (wholePart == 0) {
        bufferChar[wholeLength++] = '0';
    } else {
        while (wholePart > 0) {
            bufferChar[wholeLength++] = '0' + (wholePart % 10);
            wholePart /= 10;
        }
    }
    
    // Reverse the whole part string
    for (int i = 0; i < wholeLength / 2; i++) {
        char temp = bufferChar[i];
        bufferChar[i] = bufferChar[wholeLength - i - 1];
        bufferChar[wholeLength - i - 1] = temp;
    }
    
    if (precision > 0) {
        // Add the decimal point
        bufferChar[wholeLength++] = '.';
        
        // Convert the fractional part to a string with the desired precision
        for (int i = 0; i < precision; i++) {
            fractionalPart *= 10;
            int digit = (int)fractionalPart;
            bufferChar[wholeLength++] = '0' + digit;
            fractionalPart -= digit;
        }
    }
    
    // Null-terminate the string
    bufferChar[wholeLength] = '\0';
}

uint16_t floatToUint16(float floatValue) {
    // Multiply the float value by 100 to preserve two decimal places
    float multipliedValue = floatValue * 100.0f;
    
    // Cast the multiplied value to uint16_t
    uint16_t uintValue = (uint16_t)multipliedValue;

    return uintValue;
}

uint16_t returnTempData(int val) {
    if (val == 1) {
        return floatToUint16(temperatures[0]);
    } else if (val == 2) {
        return floatToUint16(temperatures[1]);
    } else if (val == 3) {
        return floatToUint16(temperatures[2]);
    } else if (val == 4) {
        return floatToUint16(temperatures[3]);
    } else {
        return 0.00;
    }
}

long long returnSDData(int val) {
    if (val == 1) {
        return value1;
    } else if (val == 2) {
        return value2;
    } else {
        return 0;
    }
}

char* returnCharBuffer() {
    return bufferChar;
}
```

## src/3D_Print_UART_Data.h
```c
#include <stdio.h>
#include <stdlib.h>
#include <string.h>
#include <math.h>
#include <ctype.h>

#include <zephyr/sys/printk.h>

//#include "3D_Print_Variables.h"

int checkUARTDataInput(const char *input, const char *check);
int extractLongLongs(const char *input);

void extractTemperatureData(const char *input, int maxNumbers);
void longLongToChar(long long num, char *str);
void floatToChar(float num, int precision);

uint16_t floatToUint16(float floatValue);
uint16_t returnTempData(int val);

uint8_t returnSDPercentage();

long long returnSDData(int val);

char* returnCharBuffer();
```

## src/3D_Print_Variables.h
```c
//char tx_buf[64];
//char bufferChar[64];

//float temperatures[4];
//long long value1, value2;

// char checkPhrase1[] = "T:";
// char checkPhrase2[] = "SD printing byte";
// char checkPhrase3[] = "Not SD printing";
```

## src/app_event.h
```c
/*
 * Copyright (c) 2021 Nordic Semiconductor ASA
 *
 * SPDX-License-Identifier: LicenseRef-Nordic-5-Clause
 */

#pragma once

#include <cstdint>

#include "event_types.h"

class LEDWidget;

enum class AppEventType : uint8_t { None = 0, Button, ButtonPushed, ButtonReleased, Timer, UpdateLedState, SensorActivate, SensorDeactivate, SensorMeasure };

enum class FunctionEvent : uint8_t { NoneSelected = 0, FactoryReset };

struct AppEvent {
	union {
		struct {
			uint8_t PinNo;
			uint8_t Action;
		} ButtonEvent;
		struct {
			void *Context;
		} TimerEvent;
		struct {
			LEDWidget *LedWidget;
		} UpdateLedStateEvent;
	};

	AppEventType Type{ AppEventType::None };
	EventHandler Handler;
};
```

## src/app_task.h
```c
/*
 * Copyright (c) 2021 Nordic Semiconductor ASA
 *
 * SPDX-License-Identifier: LicenseRef-Nordic-5-Clause
 */

#pragma once

#include "app_event.h"
#include "led_widget.h"

#include "3D_Print_UART_Data.h"

#include <platform/CHIPDeviceLayer.h>

#if CONFIG_CHIP_FACTORY_DATA
#include <platform/nrfconnect/FactoryDataProvider.h>
#else
#include <platform/nrfconnect/DeviceInstanceInfoProviderImpl.h>
#endif

struct k_timer;

class AppTask {
public:

	static AppTask &Instance()
	{
		static AppTask sAppTask;
		return sAppTask;
	};

	CHIP_ERROR StartApp();

	static void PostEvent(const AppEvent &event);
	static void SensorActivateHandler(const AppEvent &);
	static void SensorDeactivateHandler(const AppEvent &);
	static void SensorMeasureHandler(const AppEvent &);

private:
	CHIP_ERROR Init();

	void CancelTimer();
	void StartTimer(uint32_t timeoutInMs);

	// void SensorTimerHandler(k_timer *timer);
	// void StartSensorTimer(uint32_t aTimeoutMs);
	// void StopSensorTimer();

	static void DispatchEvent(const AppEvent &event);
	static void UpdateLedStateEventHandler(const AppEvent &event);
	static void FunctionHandler(const AppEvent &event);
	static void FunctionTimerEventHandler(const AppEvent &event);

	static void ChipEventHandler(const chip::DeviceLayer::ChipDeviceEvent *event, intptr_t arg);
	static void ButtonEventHandler(uint32_t buttonState, uint32_t hasChanged);
	static void LEDStateUpdateHandler(LEDWidget &ledWidget);
	static void FunctionTimerTimeoutCallback(k_timer *timer);
	static void UpdateStatusLED();

	FunctionEvent mFunction = FunctionEvent::NoneSelected;
	bool mFunctionTimerActive = false;

#if CONFIG_CHIP_FACTORY_DATA
	chip::DeviceLayer::FactoryDataProvider<chip::DeviceLayer::InternalFlashFactoryData> mFactoryDataProvider;
#endif
};
```
